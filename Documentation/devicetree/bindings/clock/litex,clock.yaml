## Documentation/devicetree/bindings/clock/litex,clock.yaml
```yaml
# SPDX-License-Identifier: GPL-2.0
%YAML 1.2
---
$id: http://devicetree.org/schemas/clock/litex,clock.yaml#
$schema: http://devicetree.org/meta-schemas/core.yaml#

title: LiteX clock control driver

description: |
  Common clock driver with MMCM unit for dynamic reconfiguration
  of up to 7 clock outputs with ability to change frequency, duty
  cycle and phase offset

maintainers:
  - Karol Gugala <kgugala@antmicro.com>
  - Mateusz Holenko <mholenko@antmicro.com>

properties:
  compatible:
    const: litex,clk

  reg:
    description: Base address and lengths of the register space

  "#clock-cells":
    description: |
      Number of cells in a clock specifier;
      Typically 0 for nodes with a single clock output
      and 1 for nodes with multiple clock outputs.

    const: 1

  "#address-cells":
    description: |
      Number of cells that are needed to form the base address
      part in the reg property.

    const: 1

  "#size-cells":
    description: |
      Used to state how many cells are in each field of a reg property

    const: 0

  clock-output-names:
    description: |
      List of strings of clock output signal names indexed
      by the first cell in the clock specifier.

    minItems: 1
    maxItems: 7
    items:
      - const: CLKOUT0
      - const: CLKOUT1
      - const: CLKOUT2
      - const: CLKOUT3
      - const: CLKOUT4
      - const: CLKOUT5
      - const: CLKOUT6

  litex,lock-timeout:
    description: |
      Number of ms to wait for MMCM to assert LOCK signal

        min: 1

  litex,drdy-timeout:
    description: |
      Number of ms to wait for MMCM to assert DRDY signal

        min: 1

  litex,sys-clock-freq:
    description: |
      System clock frequency

  litex,divclk-divide-min:
    description: |
      minimal global divider
  litex,divclk-divide-max:
    description: |
      maximal global divider
  litex,clkfbout-mult-min:
    description: |
      minimal global multiplier
  litex,clkfbout-mult-max:
    description: |
      maximal global multiplier
  litex,vco-freq-min:
    description: |
      minimal frequency after global divider and multiplier
  litex,vco-freq-max:
    description: |
      maximal frequency after global divider and multiplier
  litex,clkout-divide-min:
    description: |
      minimal clock output divider
  litex,clkout-divide-max:
    description: |
      maximal clock output divider
  litex,vco-margin:
    description: |
      tolerancy for vco frequency
    const: 0

  CLKOUTx:
    description: |
      Child node representing configurable clock outputs of MMCM unit

    properties:
      compatible:
        const: litex,clk

      reg:
        description: |
          clock output ID, zero-based numbering

      litex,clock-frequency:
        description: |
          default frequency in Hz for clock output

      litex,clock-phase:
        description: |
          default phase offset given in degrees

        min: 0
        max: 359

      litex,clock-duty-num:
        description: |
          default duty cycle numerator value

        min: 1
        max: 100

      litex,clock-duty-den:
        description: |
          default duty cycle denominator value

        min: 1
        max: 100

      litex,clock-margin:
        description: |
          clock output margin coefficient

      litex,clock-margin-exp:
        description: |
          exponent for clkout margin
          effective clkout margin shall be
          margin * 10^(-exponent) * 100%

    required:
      - all properties

required:
  - all properties

examples:
  - |
clk0: clk@f0009800 {
	compatible = "litex,clk";
	reg = <0x0 0xf0009800 0x0 0x100>;
	#clock-cells = <1>;
	#address-cells = <1>;
	#size-cells = <0>;
	clock-output-names =
			"CLKOUT0",
			"CLKOUT1";

	litex,lock-timeout = <10>;
	litex,drdy-timeout = <10>;
	litex,sys-clock-frequency = <100000000>;
	litex,divclk-divide-min = <1>;
	litex,divclk-divide-max = <107>;
	litex,clkfbout-mult-min = <2>;
	litex,clkfbout-mult-max = <65>;
	litex,vco-freq-min = <600000000>;
	litex,vco-freq-max = <1200000000>;
	litex,clkout-divide-min = <1>;
	litex,clkout-divide-max = <129>;
	litex,vco-margin = <0>;

	CLKOUT0: CLKOUT0 {
		compatible = "litex,clk";
		#clock-cells =	<0>;
		clock-output-names = "CLKOUT0";
		reg = <0>;
		litex,clock-frequency = <100000000>;
		litex,clock-phase = <0>;
		litex,clock-duty-num = <50>;
		litex,clock-duty-den = <100>;
		litex,clock-margin = <1>;
		litex,clock-margin-exp = <2>;
	};
	CLKOUT1: CLKOUT1 {
		compatible = "litex,clk";
		#clock-cells =	<0>;
		clock-output-names = "CLKOUT1";
		reg = <1>;
		litex,clock-frequency = <100000000>;
		litex,clock-phase = <0>;
		litex,clock-duty-num = <50>;
		litex,clock-duty-den = <100>;
		litex,clock-margin = <1>;
		litex,clock-margin-exp = <2>;
	};
};
...
```

## arch/riscv/configs/litex_defconfig
```kconfig
CONFIG_BLK_DEV_INITRD=y
CONFIG_DEVTMPFS=y
CONFIG_DEVTMPFS_MOUNT=y
CONFIG_OF=y
CONFIG_SERIAL_LITEUART=y
CONFIG_SERIAL_LITEUART_CONSOLE=y
# CONFIG_HWMON is not set
# CONFIG_USB_SUPPORT is not set
CONFIG_MMC=y
CONFIG_MMC_TEST=y
CONFIG_MMC_DEBUG=y
CONFIG_MMC_LITEX=y
# CONFIG_VIRTIO_MENU is not set
CONFIG_MSDOS_FS=y
CONFIG_VFAT_FS=y
CONFIG_FAT_DEFAULT_UTF8=y
CONFIG_NLS_CODEPAGE_437=y
CONFIG_NLS_CODEPAGE_850=y
CONFIG_NLS_CODEPAGE_852=y
CONFIG_NLS_ISO8859_1=y
CONFIG_NLS_ISO8859_2=y
CONFIG_CRYPTO=y
CONFIG_CRYPTO_AES=y
CONFIG_PRINTK_TIME=y
CONFIG_DYNAMIC_DEBUG=y
CONFIG_FRAME_WARN=1024
# CONFIG_UNUSED_SYMBOLS is not set
CONFIG_DEBUG_FS=y
CONFIG_STACKTRACE=y
# CONFIG_RUNTIME_TESTING_MENU is not set
```
